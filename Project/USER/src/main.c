/*********************************************************************************************************************
 * COPYRIGHT NOTICE
 * Copyright (c) 2020,逐飞科技
 * All rights reserved.
 * 技术讨论QQ群：一群：179029047(已满)  二群：244861897(已满)  三群：824575535
 *
 * 以下所有内容版权均属逐飞科技所有，未经允许不得用于商业用途，
 * 欢迎各位使用并传播本程序，修改内容时必须保留逐飞科技的版权声明。
 *
 * @file       		main
 * @company	   		成都逐飞科技有限公司
 * @author     		逐飞科技(QQ790875685)
 * @version    		查看doc内version文件 版本说明
 * @Software 		MDK FOR C251 V5.60
 * @Target core		STC32
 * @Taobao   		https://seekfree.taobao.com/
 * @date       		2023-07-27

 ********************************************************************************************************************/
#include "headfile.h"
#define P33 PWMB_CH3_P33
#define BEEP P32

// 关于内核频率的设定，可以查看board.h文件
// 在board_init中,已经将P54引脚设置为复位
// 如果需要使用P54引脚,可以在board.c文件中的board_init()函数中删除SET_P54_RESRT即可

/*    	每日一拜 好过校赛             天天参拜 稳过省赛        */
/* \\ \\ \\ \\ \\ \\ \\ || || || || || || // // // // // // // //
\\ \\ \\ \\ \\ \\ \\        _ooOoo_          // // // // // // //
\\ \\ \\ \\ \\ \\          o8888888o            // // // // // //
\\ \\ \\ \\ \\             88" . "88               // // // // //
\\ \\ \\ \\                (| -_- |)                  // // // //
\\ \\ \\                   O\  =  /O                     // // //
\\ \\                   ____/`---'\____                     // //
\\                    .'  \\|     |//  `.                      //
==                   /  \\|||  :  |||//  \                     ==
==                  /  _||||| -:- |||||-  \                    ==
==                  |   | \\\  -  /// |   |                    ==
==                  | \_|  ''\---/''  |   |                    ==
==                  \  .-\__  `-`  ___/-. /                    ==
==                ___`. .'  /--.--\  `. . ___                  ==
==              ."" '<  `.___\_<|>_/___.'  >'"".               ==
==            | | :  `- \`.;`\ _ /`;.`/ - ` : | |              \\
//            \  \ `-.   \_ __\ /__ _/   .-` /  /              \\
//      ========`-.____`-.___\_____/___.-`____.-'========      \\
//                           `=---='                           \\
// //   ^^^^^^^^^^^^^^^^^^^^^^^^^^^^^^^^^^^^^^^^^^^^^^^^^^  \\ \\
// // //      佛祖保佑      永无BUG      永不修改			 \\ \\ \\
// // // // // // || || || || || || || || || || \\ \\ \\ \\ \\ */

uint8 UI_count = 0, time_count = 0;
void main()
{
		DisableGlobalIRQ();								//关闭总中断

		clock_init(SYSTEM_CLOCK_52M);					// 初始化系统频率,勿删除此句代码。
		board_init();									// 初始化寄存器,勿删除此句代码。

    // 此处编写用户代码 例如外设初始化代码等
 
		lcd_init();							//LCD屏幕初始化
		Motor_Command_Init();				//电机初始化
		pwm_init(P33,50,0);					//舵机初始化
		Servo_Init();						//舵机参数初始化
		Adinductance_init();				//电感初始化
		pit_timer_ms(TIM_1, 2);				//2ms执行定时器1中断
		EnableGlobalIRQ();					//开启总中断

		

    // 此处编写用户代码 例如外设初始化代码等
	
    while(1)
    {
		// 此处编写需要循环执行的代码
		if (P50 == 0) {
			UI_count++;
			lcd_clear(WHITE);
		}
		if (P51 == 0) {
			if (UI_count == 0) {
				lcd_showstr(0, 4, "ERROR");		//减小保护
			}
			else { 
				UI_count--;
				lcd_clear(WHITE);
			};
		}

		Electroma_UI();

		delay_ms(1);
    // 此处编写需要循环执行的代码
    }
}


